## components/compressor_control/Kconfig
```kconfig
menu "Compressor Control Configuration"

    config COMPRESSOR_UART_PORT_NUM
        int "Compressor UART Port Number"
        range 0 2
        default 2
        help
            UART port for the compressor.

    config COMPRESSOR_BAUD_RATE
        int "Compressor UART Baud Rate"
        default 9600
        help
            Specify the baud rate for the compressor's UART communication.

    config COMPRESSOR_TX_PIN
        int "Compressor UART TX Pin"
        default 19
        help
            TX pin for the compressor's UART.

    config COMPRESSOR_RX_PIN
        int "Compressor UART RX Pin"
        default 20
        help
            RX pin for the compressor's UART.

endmenu
```

## components/uart_service/Kconfig
```kconfig
menu "UART Service Configuration"  

    config UART_SERVICE_PORT_NUM  
        int "UART Port Number"  
        range 0 2  
        default 1  
        help  
            Select the UART port number to be used by the service.  

    config UART_SERVICE_BAUD_RATE  
        int "UART Baud Rate"  
        default 115200  
        help  
            Specify the baud rate for the UART communication.  

    config UART_SERVICE_TX_PIN  
        int "UART TX Pin"  
        default 17  
        help  
            GPIO pin number for UART TX.  

    config UART_SERVICE_RX_PIN  
        int "UART RX Pin"  
        default 18  
        help  
            GPIO pin number for UART RX.  

endmenu  
```
